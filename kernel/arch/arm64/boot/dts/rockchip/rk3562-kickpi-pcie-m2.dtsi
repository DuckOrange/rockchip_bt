
/ {
        vcc3v3_pcie20: vcc3v3-pcie20 {
                compatible = "regulator-fixed";
                regulator-name = "vcc3v3_pcie20";
                regulator-min-microvolt = <3300000>;
                regulator-max-microvolt = <3300000>;
                enable-active-high;
                regulator-boot-on;
                regulator-always-on;
                gpios = <&gpio3 RK_PC5 GPIO_ACTIVE_HIGH>;
                startup-delay-us = <5000>;
                vin-supply = <&dc_12v>;
        };
};

&combphy_pu {
        status = "okay";
};

&pcie2x1 {
        reset-gpios = <&gpio3 RK_PB0 GPIO_ACTIVE_HIGH>;
        vpcie3v3-supply = <&vcc3v3_pcie20>;
        status = "okay";
};

